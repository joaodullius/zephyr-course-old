## prj.conf
```kconfig
#Config Serial
CONFIG_SERIAL=y

#RTT
CONFIG_USE_SEGGER_RTT=y

#Config console
CONFIG_RTT_CONSOLE=y
CONFIG_UART_CONSOLE=n

# Config logger
CONFIG_LOG=y
CONFIG_LOG_MODE_IMMEDIATE=y
CONFIG_LOG_BACKEND_RTT=y
CONFIG_LOG_BACKEND_UART=n
```

## src/main.c
```c
/*
 * Copyright (c) 2022 Joao Dullius
 *
 * SPDX-License-Identifier: Apache-2.0
 */

#include <zephyr/kernel.h>
#include <zephyr/drivers/uart.h>

#include <zephyr/logging/log.h>
LOG_MODULE_REGISTER(uart_app);

#define UART_NODE DT_NODELABEL(uart0)

void main(void)
{
	unsigned char recv_char;
    LOG_INF("Hello UART");

    const struct device *uart = DEVICE_DT_GET(UART_NODE);
    	if (uart == NULL || !device_is_ready(uart)) {
		    LOG_ERR("Could not open UART");
		    return;
	    }
	
	while(1) {
		while(uart_poll_in(uart, &recv_char) < 0){
			k_yield();
		}
		uart_poll_out(uart, recv_char);
		LOG_INF("Received Char = %c", recv_char);
		k_yield();
	}
    
}
```
