## CMakeLists.txt
```
# SPDX-License-Identifier: Apache-2.0

cmake_minimum_required(VERSION 3.20.0)

find_package(Zephyr REQUIRED HINTS $ENV{ZEPHYR_BASE})
project(pisca_led)

target_sources(app PRIVATE src/main.c)
```

## Kconfig
```
config LED_BLINK_PERIOD
    int "Define Led Blink Period in ms"
    default 1000

config TESTE
    bool "Enable Teste"
    default not

source "Kconfig.zephyr"
```

## prj.conf
```kconfig
CONFIG_LED_BLINK_PERIOD=500
```

## fast.conf
```kconfig
CONFIG_LED_BLINK_PERIOD=200
```

## src/main.c
```c
/*
 * Copyright (c) 2022 Joao Dullius
 *
 * SPDX-License-Identifier: Apache-2.0
 */

#include <zephyr/zephyr.h>
#include <zephyr/drivers/gpio.h>

#define LED0_NODE DT_ALIAS(led0)

const struct gpio_dt_spec led = GPIO_DT_SPEC_GET(LED0_NODE, gpios);

void main(void)
{
    uint8_t ret;
    printk("Hello Led");

    if (!device_is_ready(led.port)) {
        return;
    }

    ret = gpio_pin_configure_dt(&led, GPIO_OUTPUT_ACTIVE);
    if (ret <0) {
        return;
    }

    while(1) {
        ret = gpio_pin_toggle_dt(&led);
        if (ret <0) {
            return;
        }
        k_msleep(CONFIG_LED_BLINK_PERIOD);
    }
}
```
