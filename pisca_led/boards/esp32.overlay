/ {
    aliases {
        led0 = &green_led;
    };
    leds {
        compatible = "gpio-leds";
        green_led: led_0 {
        gpios = <&gpio0 5 GPIO_ACTIVE_HIGH>;
        label = "Green - LED0";
        };
    };
};
    